## sdkconfig.defaults
```kconfig
# Necessary for the LED screen demos
#CONFIG_ESP_MAIN_TASK_STACK_SIZE=7000

# NAPT demo (router)
#CONFIG_LWIP_L2_TO_L3_COPY=y
#CONFIG_LWIP_IP_FORWARD=y
#CONFIG_LWIP_IPV4_NAPT=y

# SPI Ethernet demo
#CONFIG_ETH_SPI_ETHERNET_DM9051=y
#CONFIG_ETH_SPI_ETHERNET_W5500=y
#CONFIG_ETH_SPI_ETHERNET_KSZ8851SNL=y

# Bigger headers are necessary for the QEMU demo
#CONFIG_HTTPD_MAX_URI_LEN=1024
#CONFIG_HTTPD_MAX_REQ_HDR_LEN=2048

# Workaround for https://github.com/espressif/esp-idf/issues/7631
CONFIG_MBEDTLS_CERTIFICATE_BUNDLE=n
CONFIG_MBEDTLS_CERTIFICATE_BUNDLE_DEFAULT_FULL=n

# Workaround for the experimental HTTP(S) TLS client demo
#CONFIG_ESP_TLS_INSECURE=y
#CONFIG_ESP_TLS_SKIP_SERVER_CERT_VERIFY=y

# Future: proper back-trace for esp32c3
#CONFIG_ESP_SYSTEM_USE_EH_FRAME=y

### TRICKS TO SAVE DRAM from MBEDTLS

# Enable TLS asymmetric in/out content length to save DRAM
#CONFIG_MBEDTLS_ASYMMETRIC_CONTENT_LEN=y
#CONFIG_MBEDTLS_SSL_OUT_CONTENT_LEN=2048

# Allow to use dynamic buffer strategy for mbedTLS
#CONFIG_MBEDTLS_DYNAMIC_BUFFER=y
#CONFIG_MBEDTLS_DYNAMIC_FREE_PEER_CERT=y
#CONFIG_MBEDTLS_DYNAMIC_FREE_CONFIG_DATA=y

### END
```

## sdkconfig.defaults.esp32
```kconfig
CONFIG_ETH_USE_OPENETH=y

#CONFIG_ESP32_DEFAULT_CPU_FREQ_MHZ=160

# run on single core
#CONFIG_FREERTOS_UNICORE=y

# disable Watchdogs, since rendering take a while
CONFIG_ESP_INT_WDT=
CONFIG_ESP_TASK_WDT=

#
# SPI RAM config
#
CONFIG_ESP32_SPIRAM_SUPPORT=y
CONFIG_SPIRAM_IGNORE_NOTFOUND=y
CONFIG_SPIRAM_TYPE_AUTO=y
# CONFIG_SPIRAM_TYPE_ESPPSRAM16 is not set
# CONFIG_SPIRAM_TYPE_ESPPSRAM32 is not set
# CONFIG_SPIRAM_TYPE_ESPPSRAM64 is not set
#CONFIG_SPIRAM_SIZE=512000
#CONFIG_SPIRAM_SPEED_40M=y
CONFIG_SPIRAM=y
#CONFIG_SPIRAM_BOOT_INIT=y
# CONFIG_SPIRAM_USE_MEMMAP is not set
# CONFIG_SPIRAM_USE_CAPS_ALLOC is not set
CONFIG_SPIRAM_USE_MALLOC=y
#CONFIG_SPIRAM_MEMTEST=y
#CONFIG_SPIRAM_MALLOC_ALWAYSINTERNAL=16384
#CONFIG_SPIRAM_TRY_ALLOCATE_WIFI_LWIP=y
#CONFIG_SPIRAM_MALLOC_RESERVE_INTERNAL=32768
#CONFIG_SPIRAM_ALLOW_BSS_SEG_EXTERNAL_MEMORY=y
# CONFIG_SPIRAM_ALLOW_NOINIT_SEG_EXTERNAL_MEMORY is not set
CONFIG_SPIRAM_CACHE_WORKAROUND=y



### TRICKS TO SAVE DRAM

# Minimal WiFi/lwIP configuration
#CONFIG_ESP32_WIFI_STATIC_RX_BUFFER_NUM=4
#CONFIG_ESP32_WIFI_DYNAMIC_TX_BUFFER_NUM=16
#CONFIG_ESP32_WIFI_DYNAMIC_RX_BUFFER_NUM=8
#CONFIG_ESP32_WIFI_AMPDU_RX_ENABLED=
#CONFIG_LWIP_TCPIP_RECVMBOX_SIZE=16
#CONFIG_LWIP_TCP_SND_BUF_DEFAULT=6144
#CONFIG_LWIP_TCP_WND_DEFAULT=6144
#CONFIG_LWIP_TCP_RECVMBOX_SIZE=8
#CONFIG_LWIP_UDP_RECVMBOX_SIZE=8
#CONFIG_ESP32_WIFI_IRAM_OPT=y
#CONFIG_ESP32_WIFI_RX_IRAM_OPT=y
#CONFIG_LWIP_IRAM_OPTIMIZATION=y

# Add RTC memory to system heap
#CONFIG_ESP32_ALLOW_RTC_FAST_MEM_AS_HEAP=y

# Allow usage of IRAM as 8bit accessible region
#CONFIG_ESP32_IRAM_AS_8BIT_ACCESSIBLE_MEMORY=y
#CONFIG_MBEDTLS_IRAM_8BIT_MEM_ALLOC=y

### END

#
# Heap memory debugging
#
#CONFIG_HEAP_POISONING_DISABLED=y
# CONFIG_HEAP_POISONING_LIGHT is not set
CONFIG_HEAP_POISONING_COMPREHENSIVE=y
#CONFIG_HEAP_TRACING_OFF=y
CONFIG_HEAP_TRACING_STANDALONE=y
# CONFIG_HEAP_TRACING_TOHOST is not set
# CONFIG_HEAP_ABORT_WHEN_ALLOCATION_FAILS is not set
CONFIG_HEAP_TRACING=y
CONFIG_HEAP_TRACING_STACK_DEPTH=2
CONFIG_HEAP_TASK_TRACKING=y

# end of Heap memory debugging
```
